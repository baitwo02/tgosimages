/dts-v1/;
/plugin/;

/ {
	compatible = "rockchip,rk3588-orangepi-5-plus", "rockchip,rk3588";

	fragment@0 {
		target-path = "/";
		__overlay__ {
			chosen {
				stdout-path = "/serial@feb50000:1500000";
				bootargs = "root=/dev/mmcblk0p2 rw console=ttyS2,1500000 console=tty1 splash=verbose consoleblank=0 earlycon=uart8250,mmio32,0xfeb50000 cpuidle.off=1 rodata=off rootwait rootfstype=ext4 loglevel=8 ubootpart=4cda819a-b7aa-46f4-bfa2-3a8b1825d142 usb-storage.quirks= cma=128M cgroup_enable=cpuset cgroup_memory=1 cgroup_enable=memory swapaccount=1";
			};
		};
	};
};
